## rt-thread/bsp/stm32/stm32f103-mini-system/board/Kconfig
```kconfig
menu "Hardware Drivers Config"

config SOC_STM32F103C8
    bool
    select SOC_SERIES_STM32F1
    default y

menu "Onboard Peripheral Drivers"

    config BSP_USING_USB_TO_USART
        bool "Enable USB TO USART (uart1)"
        select BSP_USING_UART
        select BSP_USING_UART1
        default y

endmenu

menu "On-chip Peripheral Drivers"

    config BSP_USING_GPIO
        bool "Enable GPIO"
        select RT_USING_PIN
        default y

    menuconfig BSP_USING_UART
        bool "Enable UART"
        default y
        select RT_USING_SERIAL
        if BSP_USING_UART
            config BSP_USING_UART1
                bool "Enable UART1"
                default y

            config BSP_UART1_RX_USING_DMA
                bool "Enable UART1 RX DMA"
                depends on BSP_USING_UART1 && RT_SERIAL_USING_DMA
                default n
        endif

    menuconfig BSP_USING_SPI
        bool "Enable SPI BUS"
        default n
        select RT_USING_SPI
        if BSP_USING_SPI
            config BSP_USING_SPI1
                bool "Enable SPI1 BUS"
                default n

            config BSP_SPI1_TX_USING_DMA
                bool "Enable SPI1 TX DMA"
                depends on BSP_USING_SPI1
                default n
                        
            config BSP_SPI1_RX_USING_DMA
                bool "Enable SPI1 RX DMA"
                depends on BSP_USING_SPI1
                select BSP_SPI1_TX_USING_DMA
                default n
        endif

     menuconfig BSP_USING_ADC
        bool "Enable ADC"
        default n
        select RT_USING_ADC
        if BSP_USING_ADC
            config BSP_USING_ADC1
                bool "Enable ADC1"
                default n

        endif
	menuconfig BSP_USING_PWM
		bool "Enable pwm"
		default n
		select RT_USING_PWM
		if BSP_USING_PWM
		menuconfig BSP_USING_PWM1
			bool "Enable timer1 output pwm"
			default n
			if BSP_USING_PWM1
				config BSP_USING_PWM1_CH4
					bool "Enable PWM1 channel4"
					default n
			endif
		menuconfig BSP_USING_PWM2
			bool "Enable timer2 output pwm"
			default n
			if BSP_USING_PWM2
				config BSP_USING_PWM2_CH3
					bool "Enable PWM2 channel3"
					default n
					
				config BSP_USING_PWM2_CH4
					bool "Enable PWM2 channel4"
					default n
			endif
		endif
endmenu

menu "Board extended module Drivers"

endmenu

endmenu
```
